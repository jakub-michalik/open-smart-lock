## firmware/Kconfig
```kconfig
# openMatterSmartLock — top-level Kconfig

mainmenu "openMatterSmartLock"

menu "Actuator driver"

rsource "drivers/actuator/servo_pwm/Kconfig"

endmenu

menu "Feedback driver"

rsource "drivers/feedback/adc_potentiometer/Kconfig"

endmenu

menu "Power gate driver"

rsource "drivers/power/gpio_gate/Kconfig"

endmenu

config OMSL_HEARTBEAT_INTERVAL_MS
    int "Heartbeat interval (ms)"
    default 5000

config OMSL_SERVO_TIMEOUT_MS
    int "Servo actuation timeout (ms)"
    default 1500

config OMSL_FACTORY_RESET_HOLD_TIME_MS
    int "Hold time on action button for factory reset (ms)"
    default 10000

config LOCK_SCHEDULES
    bool "Support user week-day and year-day schedules"
    default n

menu "Memory tuning (advanced)"

config OMSL_HEAP_HEADROOM_PCT
    int "Reserved heap headroom percentage"
    default 15

config OMSL_LOG_HEARTBEAT_STACKS
    bool "Log stack high-water marks on each heartbeat"
    default n

endmenu

# NCS Matter sample-common support and CHIP module integration.
# These provide CONFIG_NCS_SAMPLE_MATTER_* and CHIP defaults.
source "${ZEPHYR_CONNECTEDHOMEIP_MODULE_DIR}/config/nrfconnect/chip-module/Kconfig.features"
source "${ZEPHYR_CONNECTEDHOMEIP_MODULE_DIR}/config/nrfconnect/chip-module/Kconfig.defaults"
source "${ZEPHYR_NRF_MODULE_DIR}/samples/matter/common/src/Kconfig"

source "Kconfig.zephyr"
```

## firmware/drivers/actuator/servo_pwm/Kconfig
```kconfig
config OMSL_ACTUATOR_SERVO_PWM
    bool "PWM servo actuator driver"
    default y
    help
      Reference actuator driver using a Zephyr PWM device bound to the
      'servo_pwm' devicetree node.
```

## firmware/drivers/feedback/adc_potentiometer/Kconfig
```kconfig
config OMSL_FEEDBACK_ADC_POTENTIOMETER
    bool "ADC potentiometer feedback driver"
    default y
    help
      Reference feedback driver using Zephyr ADC for battery voltage
      and optional actuator position sampling.
```

## firmware/drivers/power/gpio_gate/Kconfig
```kconfig
config OMSL_POWER_GPIO_GATE
    bool "GPIO-controlled power gate driver"
    default y
```

## firmware/dts/bindings/actuator-servo-pwm.yaml
```yaml
# Copyright (c) 2025 openMatterSmartLock contributors
# SPDX-License-Identifier: Apache-2.0

description: |
  PWM servo actuator binding for openMatterSmartLock. Declares the PWM
  channel driving the servo and an optional enable-gpios line for
  power-gating the servo rail when idle.

compatible: "omsl,actuator-servo-pwm"

properties:
  pwms:
    type: phandle-array
    required: true
    description: PWM channel driving the servo signal line.

  enable-gpios:
    type: phandle-array
    required: false
    description: Optional GPIO controlling the servo power rail.

  locked-pulse-us:
    type: int
    required: false
    default: 1000
    description: PWM pulse width (microseconds) corresponding to the locked position.

  unlocked-pulse-us:
    type: int
    required: false
    default: 2000
    description: PWM pulse width (microseconds) corresponding to the unlocked position.
```

## firmware/sample.yaml
```yaml
sample:
  description: openMatterSmartLock Matter Door Lock
  name: omsl

tests:
  sample.omsl.nanoBoard:
    platform_allow: nanoBoard
    integration_platforms:
      - nanoBoard
    tags: matter door-lock
  sample.omsl.nanoBoard:
    platform_allow: nanoBoard
    integration_platforms:
      - nanoBoard
    tags: matter door-lock
```

## firmware/west.yml
```yaml
manifest:
  remotes:
    - name: nrfconnect
      url-base: https://github.com/nrfconnect

  projects:
    - name: sdk-nrf
      remote: nrfconnect
      revision: v3.1.1
      path: nrf
      import: true

  self:
    path: openMatterSmartLock
```

## tests/unit/testcase.yaml
```yaml
common:
  platform_allow: native_sim
  tags: omsl unit

tests:
  omsl.unit.bolt: {}
  omsl.unit.roster: {}
```
